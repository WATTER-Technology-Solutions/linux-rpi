// Definitions for AD7998 ADC

/dts-v1/;
/plugin/;

#include "i2c-buses.dtsi"

/ {
	fragment@1 {
		target = <&ad7998>;
		__dormant__ {
			compatible = "ad7998";
		};
	};

	fragment@2 {
		target = <&i2cbus>;
		__overlay__ {
			#address-cells = <1>;
			#size-cells = <0>;

			ad7998: ad7998@23 {
				compatible = "ad7998";
				reg = <0x23>;
				vcc-supply = <&fixedregulator_3v0>;
				vcc-supply-voltage = "3.0";
				label = "UNKNOWN";
				status = "okay";
			};
		};
	};

	__overrides__ {
		label = <&ad7998>,"label";
		addr  = <&ad7998>,"reg:0";
	};
};
