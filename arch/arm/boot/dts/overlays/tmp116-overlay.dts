// Definitions for TMP116 ADC

/dts-v1/;
/plugin/;

#include "i2c-buses.dtsi"

/ {
	fragment@1 {
		target = <&tmp116>;
		__dormant__ {
			compatible = "ti,tmp116";
		};
	};

	fragment@2 {
		target = <&i2cbus>;
		__overlay__ {
			#address-cells = <1>;
			#size-cells = <0>;

			tmp116: tmp116@48 {
				compatible = "ti,tmp116";
				reg = <0x48>;

				status = "okay";
			};
		};
	};

	__overrides__ {
		addr = <&tmp116>,"reg:0";
	};
};
