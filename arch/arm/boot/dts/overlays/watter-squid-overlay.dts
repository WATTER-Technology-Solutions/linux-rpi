// SPDX-License-Identifier: (GPL-2.0 OR MIT)
/dts-v1/;
/plugin/;

/ {
        compatible = "brcm,bcm2835";

	fragment@0 {
		target = <&rp1_gpio>;

		__overlay__ {
			gpio-line-names =
				"ID_SDA", // GPIO0
				"ID_SCL", // GPIO1
				"GPIO2", // GPIO2
				"GPIO3", // GPIO3
				"valve-closed", // GPIO4
				"water-pump", // GPIO5
				"valve-opened", // GPIO6
				"GPIO7", // GPIO7
				"GPIO8", // GPIO8
				"GPIO9", // GPIO9
				"GPIO10", // GPIO10
				"GPIO11", // GPIO11
				"GPIO12", // GPIO12
				"w1-ambient-temp", // GPIO13
				"GPIO14", // GPIO14
				"GPIO15", // GPIO15
				"pc-power-button", // GPIO16
				"valve-actuate", // GPIO17
				"pc-exhaust-fan", // GPIO18
				"GPIO19", // GPIO19
				"GPIO20", // GPIO20
				"w1-fluid-reservoir-temp", // GPIO21
				"GPIO22", // GPIO22
				"heat-element", // GPIO23
				"coolant-pump", // GPIO24
				"pc-contactor", // GPIO25
				"pc-reset", // GPIO26
				"w1-water-temp", // GPIO27

				"PCIE_RP1_WAKE", // GPIO28
				"FAN_TACH", // GPIO29
				"HOST_SDA", // GPIO30
				"HOST_SCL", // GPIO31
				"ETH_RST_N", // GPIO32
				"-", // GPIO33

				"CD0_IO0_MICCLK", // GPIO34
				"CD0_IO0_MICDAT0", // GPIO35
				"RP1_PCIE_CLKREQ_N", // GPIO36
				"-", // GPIO37
				"CD0_SDA", // GPIO38
				"CD0_SCL", // GPIO39
				"CD1_SDA", // GPIO40
				"CD1_SCL", // GPIO41
				"USB_VBUS_EN", // GPIO42
				"USB_OC_N", // GPIO43
				"RP1_STAT_LED", // GPIO44
				"FAN_PWM", // GPIO45
				"CD1_IO0_MICCLK", // GPIO46
				"2712_WAKE", // GPIO47
				"CD1_IO1_MICDAT1", // GPIO48
				"EN_MAX_USB_CUR", // GPIO49
				"-", // GPIO50
				"-", // GPIO51
				"-", // GPIO52
				"-"; // GPIO53
		};
	};

	__overrides__ {
	};
};
